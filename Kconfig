## Kconfig
```kconfig
menuconfig INPUT_PINNACLE_POLLING
	bool "Cirque Pinnacle trackpad without a data-ready pin"
	default y
	depends on I2C
	depends on INPUT
	depends on DT_HAS_CIRQUE_PINNACLE_POLLING_ENABLED
	help
	  Enable the local polling driver for a Cirque Pinnacle trackpad connected
	  over I2C without the hardware data-ready signal.
```

## dts/bindings/input/cirque,pinnacle-polling.yaml
```yaml
# Copyright (c) 2026
# SPDX-License-Identifier: MIT

description: Cirque Pinnacle trackpad polled over I2C without a data-ready pin

compatible: "cirque,pinnacle-polling"

include:
  - name: i2c-device.yaml
  - name: cirque,pinnacle-common.yaml
    property-blocklist:
      - data-ready-gpios

properties:
  poll-interval-ms:
    type: int
    default: 4
    description: Interval between Status1 register checks in milliseconds.

  movement-scale:
    type: int
    default: 1
    description: Multiplier applied to relative X/Y movement.
```

## west.yml
```yaml
manifest:
  defaults:
    revision: main
  remotes:
    - name: zmkfirmware
      url-base: https://github.com/zmkfirmware
  projects:
    - name: zmk
      path: zmk
      remote: zmkfirmware
      import: app/west.yml
  self:
    path: .
```
